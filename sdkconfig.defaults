## sdkconfig.defaults
```kconfig
CONFIG_IDF_TARGET="esp32p4"
CONFIG_ESP32P4_SELECTS_REV_LESS_V3=y
CONFIG_ESPTOOLPY_FLASHMODE_DIO=y
CONFIG_ESPTOOLPY_FLASHFREQ_40M=y
CONFIG_ESPTOOLPY_FLASHSIZE_16MB=y
CONFIG_SPIRAM=y
CONFIG_SPIRAM_SPEED_200M=y
CONFIG_SPIRAM_BOOT_INIT=y
CONFIG_SPIRAM_MEMTEST=y
CONFIG_SPIRAM_USE_MALLOC=y
CONFIG_SPIRAM_MALLOC_ALWAYSINTERNAL=16384
CONFIG_SPIRAM_MALLOC_RESERVE_INTERNAL=65536
CONFIG_PARTITION_TABLE_CUSTOM=y
CONFIG_PARTITION_TABLE_CUSTOM_FILENAME="partitions.csv"
CONFIG_ESP_MAIN_TASK_STACK_SIZE=8192
CONFIG_FATFS_LFN_HEAP=y
CONFIG_FATFS_MAX_LFN=255
CONFIG_FATFS_FS_LOCK=16
CONFIG_BSP_ERROR_CHECK=n
CONFIG_BSP_SD_MOUNT_POINT="/sdcard"
CONFIG_BSP_SD_FORMAT_ON_MOUNT_FAIL=n
CONFIG_BSP_LCD_DRAW_BUF_HEIGHT=60
CONFIG_BSP_LCD_DRAW_BUF_DOUBLE=y
CONFIG_BSP_LCD_DPI_BUFFER_NUMS=1
CONFIG_BSP_DISPLAY_LVGL_AVOID_TEAR=n
CONFIG_LV_COLOR_DEPTH_16=y
CONFIG_LV_USE_CLIB_MALLOC=y
CONFIG_LV_USE_CLIB_SPRINTF=y
CONFIG_LV_USE_CLIB_STRING=y
CONFIG_LV_FONT_MONTSERRAT_20=y
CONFIG_LV_FONT_MONTSERRAT_24=y
CONFIG_LV_FONT_MONTSERRAT_32=y
CONFIG_LV_FONT_DEFAULT_MONTSERRAT_20=y
CONFIG_LV_BUILD_EXAMPLES=n
CONFIG_LV_BUILD_DEMOS=n
CONFIG_SERIAL_FLASHER_PORT_UART=n
CONFIG_SERIAL_FLASHER_PORT_USB_CDC_ACM=n
CONFIG_ESP_CONSOLE_USB_SERIAL_JTAG=y
CONFIG_ESP_CONSOLE_SECONDARY_NONE=y
CONFIG_CODEC_I2C_BACKWARD_COMPATIBLE=n
CONFIG_CAM_CTRL_SPI_ENABLE=n
CONFIG_TINYUSB_MSC_ENABLED=y
CONFIG_TINYUSB_MSC_BUFSIZE=4096
CONFIG_TINYUSB_CDC_ENABLED=n
CONFIG_TINYUSB_DESC_PRODUCT_STRING="Tab5 SD Card"
CONFIG_TINYUSB_DESC_MANUFACTURER_STRING="Tab5-Burner"
CONFIG_TINYUSB_DESC_SERIAL_STRING=""
CONFIG_TINYUSB_DESC_MSC_STRING="Tab5 microSD"
```
